#include <SPI.h>
#include <nRF24L01.h>
#include <RF24.h>
#include <Wire.h>               
#include <Adafruit_GFX.h>   
#include <Adafruit_SSD1306.h>
#define SCREEN_WIDTH 128 // OLED ekran genişliği (piksel)
#define SCREEN_HEIGHT 64 // OLED ekran yüksekliği (piksel)
#define OLED_RESET -1    // OLED ekran reset pinini belirtmek için -1 kullanılır (bu pin kullanılmayacak)
int egimAckapa=0;
int servoYon1=0;
int servoYon2=0;
int servoYon3=0;
int servoYon4=0;
int egimKontrolu=0;
bool reverse = false;
bool settings = false;
bool joystik = false;
bool joystik2 = false;
int isRunning=0;
int selecteded = 0; // seçili olan menüyü belirtir
int entereded = 0;  // seçili olan menüyü aktifleştirir
int selected = 0; // seçili olan menüyü belirtir
int entered = 0;  // seçili olan menüyü aktifleştirir
int buttonState = 0;
int rectX = SCREEN_WIDTH / 2; // Dikdörtgenin x koordinatı
int rectY = SCREEN_HEIGHT / 2 - 3; // Dikdörtgenin y koordinatı
const int rectWidth = 6;
const int rectHeight = 4;
int servo1Trim=0;
int servo2Trim=0;
int servo1Deger;
int servo2Deger;

int screenControl=0;
  #define buton A7
byte buton_bul(int x){
int buton_numarasi = 0;
  if (x > 1000)
    buton_numarasi = 5;
  else if (x > 980 && x < 999)
    buton_numarasi = 6;
  else if (x > 950 && x < 970)
    buton_numarasi = 7;
  else if (x > 920 && x < 940)
    buton_numarasi = 8;
    else if (x > 895 && x < 915)
    buton_numarasi = 1;
    else if (x > 870 && x < 890)
    buton_numarasi = 2;
    else if (x > 855 && x < 867)
    buton_numarasi = 4;
    else if (x > 820 && x < 850)
    buton_numarasi = 3;
  else
    buton_numarasi = 0;

  return buton_numarasi;
}

Adafruit_SSD1306 display(SCREEN_WIDTH, SCREEN_HEIGHT, &Wire, OLED_RESET);
const uint64_t my_radio_pipe = 0xE8E8F0F0E1LL; 

RF24 radio(9, 10);  //Set CE and CSN pins


struct Data_to_be_sent {
  byte ch1;
  byte ch2;
  byte ch3;
  byte ch4;
 };


Data_to_be_sent sent_data;

//   ekrandaki menü tasarımı  ANA MENU
const unsigned char epd_bitmap_Yeni_Proje [] PROGMEM = {
	0xff, 0xff, 0xff, 0x3f, 0xff, 0xff, 0xcf, 0xff, 0xff, 0xf3, 0xff, 0xff, 0xfc, 0xff, 0xff, 0xff, 
	0x80, 0x00, 0x01, 0x20, 0x00, 0x00, 0x48, 0x00, 0x00, 0x12, 0x00, 0x00, 0x04, 0x80, 0x00, 0x01, 
	0x80, 0x00, 0x01, 0x20, 0x00, 0x00, 0x48, 0x00, 0x00, 0x12, 0x00, 0x00, 0x04, 0x80, 0x00, 0x01, 
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	0xff, 0xff, 0xff, 0x3f, 0xff, 0xff, 0xcf, 0xff, 0xff, 0xf3, 0xff, 0xff, 0xfc, 0xff, 0xff, 0xff

};
const unsigned char epd_bitmap_Yeni_Proje_MENU_3 [] PROGMEM = {
	0x1f, 0xff, 0xff, 0xff, 0xff, 0xff, 0xff, 0xff, 0xff, 0xff, 0xff, 0xff, 0xff, 0xff, 0xff, 0xf8, 
	0x20, 0x00, 0x00, 0x00, 0x00, 0x00, 0x00, 0x00, 0x00, 0x00, 0x00, 0x00, 0x00, 0x00, 0x00, 0x04, 
	0x40, 0x00, 0x00, 0x00, 0x00, 0x00, 0x00, 0x00, 0x00, 0x00, 0x00, 0x00, 0x00, 0x00, 0x00, 0x02, 
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	0x1f, 0xff, 0xff, 0xff, 0xff, 0xff, 0xff, 0xff, 0xff, 0xff, 0xff, 0xff, 0xff, 0xff, 0xff, 0xf8
};
const unsigned char epd_bitmap_JOYSTIK [] PROGMEM = {
	0x00, 0x00, 0x00, 0x00, 0x00, 0x00, 0x00, 0x00, 0x00, 0x00, 0x00, 0x00, 0x00, 0x00, 0x00, 0x00, 
	0x00, 0x00, 0x00, 0x00, 0x00, 0x00, 0x00, 0x00, 0x00, 0x00, 0x00, 0x00, 0x00, 0x00, 0x00, 0x00, 
	0x00, 0x00, 0x00, 0x00, 0x00, 0x00, 0x00, 0x00, 0x00, 0x00, 0x00, 0x00, 0x00, 0x00, 0x00, 0x00, 
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	0x00, 0x00, 0x00, 0x00, 0x00, 0x00, 0x00, 0x00, 0x00, 0x00, 0x00, 0x00, 0x00, 0x00, 0x00, 0x00
};
const unsigned char epd_bitmap_Logo [] PROGMEM = {
	0x00, 0x00, 0x00, 0x00, 0x00, 0x00, 0x00, 0x00, 0x00, 0x00, 0x00, 0x00, 0x00, 0x00, 0x00, 0x00, 
	0x00, 0x00, 0x00, 0x00, 0x00, 0x00, 0x00, 0x00, 0x00, 0x00, 0x00, 0x00, 0x00, 0x00, 0x00, 0x00, 
	0x00, 0x00, 0x00, 0x00, 0x00, 0x00, 0x00, 0x00, 0x00, 0x00, 0x00, 0x00, 0x00, 0x00, 0x00, 0x00, 
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	0x00, 0x00, 0x00, 0x00, 0x00, 0x00, 0x00, 0x00, 0x00, 0x00, 0x00, 0x00, 0x00, 0x00, 0x00, 0x00
};
const unsigned char epd_bitmap_Somy [] PROGMEM = {
	0x00, 0x00, 0x00, 0x00, 0x00, 0x00, 0x00, 0x00, 0x00, 0x00, 0x00, 0x00, 0x00, 0x00, 0x00, 0x00, 
	0x00, 0x00, 0x00, 0x00, 0x00, 0x00, 0x00, 0x00, 0x00, 0x00, 0x00, 0x00, 0x00, 0x00, 0x00, 0x00, 
	0x00, 0x00, 0x00, 0x00, 0x00, 0x00, 0x00, 0x00, 0x00, 0x00, 0x00, 0x00, 0x00, 0x00, 0x00, 0x00, 
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	0x00, 0x00, 0x00, 0x00, 0x00, 0x00, 0x00, 0x00, 0x00, 0x00, 0x00, 0x00, 0x00, 0x00, 0x00, 0x00
};



bool acikDurum = false;
void drawBlinkingSymbols(int startX, int startY, bool acikDurum = false) {
  int pieceWidth = 24;
  int pieceHeight = 30;
  int interval = 2;

  // Dikdörtgeni çizmek için
  display.drawRect(startX, startY, pieceWidth, pieceHeight, WHITE);

  // Kareyi çizmek için
  if (acikDurum) {
    // Kareyi yukarı doğru çiz
    display.drawRect(startX + 5, startY, 12, 12, WHITE);
  } else {
    // Kareyi aşağı doğru çiz
    display.drawRect(startX + 5, startY + 18, 12, 12, WHITE);
  }
}

void setup()
{
  Serial.begin(9600);
 radio.begin();
radio.setAutoAck(false);
 radio.setDataRate(RF24_250KBPS);
  radio.openWritingPipe(my_radio_pipe);

  //Reset each channel value
  sent_data.ch1 = 127;
  sent_data.ch2 = 127;
  sent_data.ch3 = 127;
  sent_data.ch4 = 0;

  // OLED ekranı başlat
  if(!display.begin(SSD1306_SWITCHCAPVCC, 0x3C)) {
    Serial.println(F("SSD1306 başlatılamadı. Bağlantıları kontrol edin!"));
    while (true);
  }
 // Ekranı temizle
  display.clearDisplay();
  display.drawBitmap(0, 0, epd_bitmap_Logo , SCREEN_WIDTH, SCREEN_HEIGHT, WHITE);
  display.display();
  delay(500);
  display.clearDisplay();
  display.drawBitmap(0, 0, epd_bitmap_Somy , SCREEN_WIDTH, SCREEN_HEIGHT, WHITE);
  display.display();

  delay(3000); 
  display.clearDisplay();
  // Ekrana bitmapi çizme
  display.drawBitmap(0, 0, epd_bitmap_Yeni_Proje_MENU_3 , SCREEN_WIDTH, SCREEN_HEIGHT, WHITE);
  reverse = false;
  settings = true;
  joystik = false;
  joystik2 = false;
  display.display();
 }




void loop()
{


  sent_data.ch1 = map( analogRead(A0), 0, 1024, 0, 255);

  if(servoYon1==0){
    servo1Deger=map( analogRead(A1), 0, 1024, 0, 255) + servo1Trim;
    if(servo1Deger>255)
    servo1Deger=255;
    else if(servo1Deger<0)
    servo1Deger=0;
    sent_data.ch2 = servo1Deger;
  }
  else if(servoYon1==1){
    servo1Deger=map( analogRead(A1), 0, 1024, 0, 255) + servo1Trim;
    if(servo1Deger>255)
    servo1Deger=255;
    else if(servo1Deger<0)
    servo1Deger=0;
    sent_data.ch2 = servo1Deger;
  }
  if(servoYon2==0){
    servo2Deger=map( analogRead(A6), 0, 1024, 0, 255) + servo2Trim;
    if(servo2Deger>255)
    servo2Deger=255;
    else if(servo2Deger<0)
    servo2Deger=0;
    sent_data.ch3 = servo2Deger;
  }
  else if(servoYon2==1){
    servo2Deger=map( analogRead(A6), 0, 1024, 255, 0) + servo2Trim;
    if(servo2Deger>255)
    servo2Deger=255;
    else if(servo2Deger<0)
    servo2Deger=0;
    sent_data.ch3 = servo2Deger;
  }
 sent_data.ch4=egimKontrolu;
  
 
 radio.write(&sent_data, sizeof(Data_to_be_sent));
int buton_deger = analogRead(buton);
  byte basilan_buton = buton_bul(buton_deger);

if(basilan_buton==5)
{
  servo1Trim+=5;
}
else if(basilan_buton==6){
  servo1Trim-=5;
}
if(basilan_buton==7)
{
  servo2Trim+=5;
}
else if(basilan_buton==8){
  servo2Trim-=5;
}

 //*************************************************************************************************** 
 Serial.println(isRunning);
 if (basilan_buton==3) { // Kontrol butonu basıldığında durumu değiştirir
  }
 else if(basilan_buton==4){
  reverse = false;
  settings = true;
  joystik = false;
  joystik2 = false;
    
  }

  //************************************************************************************************************************
if (settings == true){
 if (basilan_buton==1){
   
  //Seçenekler arasında gezmek için
  selected = selected + 1;

  if(selected > 2){
    selected = 0;  }

    entered++;
  if (entered > 2) {
    entered = 0;} 
 }
 if (basilan_buton == 2){
 switch (entered){
    case 0:
    menupage0();  
    break;
    case 1:
    menupage1();  
    break;
    case 2:  
    menupage2();  
    break;
    default:
    display.display();
    break;
  }
  
  int arrowX = 110; // X konumu sabit, menünün sol tarafında
  int arrowY = 10;
}
drawArrow(selected);
display.display();
}


  //************************************************************************************************************************
  if (reverse == true){
  if(isRunning==0){
  if(basilan_buton==1){
    
  //Seçenekler arasında gezmek için
  selecteded = selecteded + 1;
  

  if(selecteded > 4){
    selecteded = 0;  }

    entereded++;
  if (entereded > 4) {
    entereded = 0;}
  }

 if(basilan_buton==2){
    switch (entereded){
    case 0:
    if(servoYon1==1){
      servoYon1=0;
    }
    else if(servoYon1==0){
      servoYon1=1;
    }
     
    break;
    case 1:
    if(servoYon2==1){
      servoYon2=0;
    }
    else if(servoYon2==0){
      servoYon2=1;
    }
      
    break;
    case 2: 
    if(servoYon3==1){
      servoYon3=0;
    }
    else if(servoYon3==0){
      servoYon3=1;
    } 
     
    break;
    case 3:  
    if(servoYon4==1){
      servoYon4=0;
    }
    else if(servoYon4==0){
      servoYon4=1;
    }
      
    break;
    case 4:
    if(egimKontrolu==1){
      egimKontrolu=0;
    }
    else if(egimKontrolu==0){
      egimKontrolu=1;
    }
     
    break;
    default:
  display.display(); 
    break;
  }
   display.display();
  int arrowX1 = 110; // X konumu sabit, menünün sol tarafında
  int arrowY1 = 10;
}
drawArrow1(selecteded);

   // Ekranı güncelle
  display.display();

}
}
if (joystik == true){
  if (isRunning ==1){
  
  if(basilan_buton == 3){
   egimAckapa=1;
   }
     if(basilan_buton == 1){
   egimAckapa=2;
     }

    drawLine1(egimAckapa);
  }
}
if (joystik2 == true){
  display.clearDisplay();
  display.drawBitmap(0, 0, epd_bitmap_Somy , SCREEN_WIDTH, SCREEN_HEIGHT, WHITE);
  display.display();
}
}
void drawLine1(int linePosition11){
  display.clearDisplay();
  display.drawBitmap(0, 0, epd_bitmap_JOYSTIK , SCREEN_WIDTH, SCREEN_HEIGHT, WHITE);
  
  // Çizgiyi ekranın ortasına çiz
  int squareSize = 10;
  int centerX2 = 64;
  int centerY2 = 12;
  int startX2 = (SCREEN_WIDTH - squareSize) / 2;
  int endX2 = (SCREEN_HEIGHT - squareSize) / 2;
  int centerX = SCREEN_WIDTH / 2 + 5;
  int centerY = SCREEN_HEIGHT / 2 - 23; // Center a little above the middle
  int rectWidth = 6;
  int rectHeight = 4;

     if (egimAckapa==1) { // Butona basıldığında
    rectX -= 3; // 3px sağa kaydır
    sent_data.ch4=0;
}
else if (egimAckapa==2){
  rectX +3;
      sent_data.ch4=1;
}
sent_data.ch4;
  
  display.fillRect(centerX - rectWidth / 2, centerY - rectHeight / 2, rectWidth, rectHeight, SSD1306_WHITE);
  display.display();

}
//***************************************************************************************************
void drawArrow1(int position1) {
  // Ekranı temizle
  display.clearDisplay();
  
  // Ekrana bitmapi çizme
  display.drawBitmap(0, 0, epd_bitmap_Yeni_Proje, SCREEN_WIDTH, SCREEN_HEIGHT, WHITE);

  // Okun konumunu belirle
  int arrowX1 = 10 + (position1 * 26); // X konumu sabit
  int arrowY1 = 55 ; // Her menü öğesi 20 piksel yüksekliğinde

  // Oku çiz
display.drawLine(arrowX1, arrowY1, arrowX1 + 8, arrowY1 + 4, WHITE);
display.drawLine(arrowX1, arrowY1, arrowX1 - 8, arrowY1 + 4, WHITE);
if(servoYon1==0){
  drawBlinkingSymbols(0, 21, !acikDurum);}
  else if(servoYon1==1){
    drawBlinkingSymbols(0, 21, acikDurum);
  }
if(servoYon2==0){
  drawBlinkingSymbols(26, 21, !acikDurum);}
  else if(servoYon2==1){
    drawBlinkingSymbols(26, 21, acikDurum);
  }
  if(egimKontrolu==0){
  drawBlinkingSymbols(104, 21, !acikDurum);}
  else if(egimKontrolu==1){
    drawBlinkingSymbols(104, 21, acikDurum);
  }
  drawBlinkingSymbols(52, 21, acikDurum);
  drawBlinkingSymbols(78, 21, acikDurum);
  
  // Ekranı güncelle
  display.display();
}
void drawArrow(int position) {
  // Ekranı temizle
  display.clearDisplay();

  // Ekrana bitmapi çizme
  display.drawBitmap(0, 0, epd_bitmap_Yeni_Proje_MENU_3, SCREEN_WIDTH, SCREEN_HEIGHT, WHITE);

  // Okun konumunu belirle
  int arrowX = 110; // X konumu sabit
  int arrowY = 10 +(position * 20); // Her menü öğesi 20 piksel yüksekliğinde

  // Oku çiz
  display.drawLine(arrowX, arrowY, arrowX + 10, arrowY + 5, WHITE);
  display.drawLine(arrowX, arrowY, arrowX + 10, arrowY - 5, WHITE);

  // Ekranı güncelle
  display.display();
}



void menupage0(){  // Menü 1 in içi 
  isRunning=0;
  reverse = true;
  settings = false;
  joystik = false;
  joystik2 = false;
  display.clearDisplay();
  display.drawBitmap(0, 0, epd_bitmap_Yeni_Proje , SCREEN_WIDTH, SCREEN_HEIGHT, WHITE);
  display.display();
}
void menupage1(){ // Menü 2 nin içi
  isRunning=1;
  reverse = false;
  settings = false;
  joystik = true;
  joystik2 = false;
}
void menupage2(){ // Menü 3 ün içi
  isRunning=2;
  reverse = false;
  settings = false;
  joystik = false;
  joystik2 = true;
  display.clearDisplay();
  display.drawBitmap(0, 0, epd_bitmap_Somy , SCREEN_WIDTH, SCREEN_HEIGHT, WHITE);
  display.display();
}

